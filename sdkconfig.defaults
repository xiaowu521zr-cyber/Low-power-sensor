## sdkconfig.defaults
```kconfig
# ESP32-C6 MPU6050 Gyroscope Sensor Node sdkconfig defaults
# Low power optimized configuration

# Target
CONFIG_IDF_TARGET="esp32c6"

# CPU Frequency - 160MHz for performance, 80MHz for power saving
CONFIG_ESP_DEFAULT_CPU_FREQ_MHZ_160=y
CONFIG_ESP_DEFAULT_CPU_FREQ_MHZ=160

# FreeRTOS
CONFIG_FREERTOS_UNICORE=n
CONFIG_FREERTOS_NUMBER_OF_CORES=1
CONFIG_FREERTOS_HZ=1000
CONFIG_FREERTOS_MAX_PRIORITIES=16

# Tickless idle for power saving
CONFIG_FREERTOS_USE_TICKLESS_IDLE=y

# Task stack sizes
CONFIG_FREERTOS_IDLE_TASK_STACKSIZE=1536
CONFIG_FREERTOS_TIMER_TASK_STACK_DEPTH=2048

# ULP LP-Core (RISC-V) co-processor
CONFIG_ULP_COPROC_ENABLED=y
CONFIG_ULP_COPROC_RISCV=y
CONFIG_ULP_COPROC_RESERVE_MEM=4096

# Power management
CONFIG_PM_ENABLE=y
CONFIG_PM_DFS_INIT_AUTO=y
CONFIG_PM_PROFILING=n

# Deep sleep wake-up sources
CONFIG_ESP_SLEEP_GPIO_ENABLE_INTERNAL_RESISTORS=y
CONFIG_ESP_SLEEP_POWER_DOWN_FLASH=y

# I2C
CONFIG_I2C_MASTER_ENABLE=y
CONFIG_I2C_ISR_IRAM_SAFE=y

# UART with DMA
CONFIG_UART_ISR_IN_IRAM=y

# SPI
CONFIG_SPI_MASTER_ENABLE=y
CONFIG_SPI_MASTER_ISR_IN_IRAM=y

# ADC for battery monitoring
CONFIG_ADC_CONTINUOUS_IN_IRAM_SAFE=y

# Log level - Info for production
CONFIG_LOG_DEFAULT_LEVEL_INFO=y
CONFIG_LOG_MAXIMUM_LEVEL_INFO=y

# Wi-Fi / BLE disabled for sensor node
CONFIG_ESP_WIFI_ENABLED=n
CONFIG_ESP_WIFI_REMOTE_ENABLED=n

# Reduce bootloader log
CONFIG_BOOTLOADER_LOG_LEVEL_WARN=y

# Partition table
CONFIG_PARTITION_TABLE_CUSTOM=y
CONFIG_PARTITION_TABLE_CUSTOM_FILENAME="partitions.csv"

# Main task stack size
CONFIG_ESP_MAIN_TASK_STACK_SIZE=4096

# Timers used for FreeRTOS
CONFIG_FREERTOS_TIMER_TASK_PRIORITY=1
```
